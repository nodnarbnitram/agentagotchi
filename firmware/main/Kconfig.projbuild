## firmware/main/Kconfig.projbuild
```kconfig
menu "Codex Pet"

config CODEX_PET_SENSOR_BAR
    bool "Enable SENSOR dock status bar"
    default y
    help
        Enable AHT30 temperature/humidity, GPIO10 battery estimation,
        and GPIO21 radar presence in the top status bar.

config CODEX_PET_LOG_SENSOR_DIAGNOSTICS
    bool "Log sensor diagnostics"
    default n
    help
        Log local sensor values over serial. Sensor values never travel
        to the Mac bridge.

endmenu
```

## firmware/sdkconfig.defaults
```kconfig
CONFIG_IDF_TARGET="esp32s3"
CONFIG_ESPTOOLPY_FLASHSIZE_16MB=y
CONFIG_ESPTOOLPY_FLASHSIZE="16MB"
CONFIG_PARTITION_TABLE_CUSTOM=y
CONFIG_PARTITION_TABLE_CUSTOM_FILENAME="partitions.csv"
CONFIG_SPIRAM=y
CONFIG_SPIRAM_MODE_OCT=y
CONFIG_SPIRAM_SPEED_80M=y
CONFIG_MBEDTLS_EXTERNAL_MEM_ALLOC=y
CONFIG_ESP_DEFAULT_CPU_FREQ_MHZ_240=y
CONFIG_ESP_MAIN_TASK_STACK_SIZE=8192
CONFIG_ESP_CONSOLE_USB_SERIAL_JTAG=y
CONFIG_ESP_CONSOLE_SECONDARY_NONE=y
CONFIG_LV_FONT_MONTSERRAT_12=y
CONFIG_LV_FONT_MONTSERRAT_14=y
CONFIG_LV_FONT_MONTSERRAT_18=y
CONFIG_LV_FONT_MONTSERRAT_24=y
CONFIG_COMPILER_OPTIMIZATION_PERF=y
CONFIG_FREERTOS_HZ=1000
CONFIG_ESP_WIFI_SLP_DEFAULT_MIN_ACTIVE_TIME=50
CONFIG_AGENTAGOTCHI_SENSOR_BAR=y
CONFIG_BSP_LCD_DRAW_BUF_HEIGHT=40
CONFIG_LV_MEM_SIZE_KILOBYTES=40
# Wi-Fi buffer trim: four-feed statics leave ~63KB internal heap at network
# start; default static RX/TX reservations (~50KB) starve the network task.
CONFIG_ESP_WIFI_STATIC_RX_BUFFER_NUM=6
CONFIG_ESP_WIFI_DYNAMIC_RX_BUFFER_NUM=24
CONFIG_ESP_WIFI_DYNAMIC_TX_BUFFER_NUM=24
```
